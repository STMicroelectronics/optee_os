## documentation/devicetree/bindings/dma/st,stm32-dma3.yaml
```yaml
# SPDX-License-Identifier: (GPL-2.0-only OR BSD-2-Clause)
%YAML 1.2
---
$id: http://devicetree.org/schemas/dma/stm32/st,stm32-dma3.yaml#
$schema: http://devicetree.org/meta-schemas/core.yaml#

title: STMicroelectronics STM32 DMA3 Controller

description: |
  The STM32 DMA3 is a direct memory access controller with different features
  depending on its hardware configuration.
  It is either called LPDMA (Low Power), GPDMA (General Purpose) or HPDMA (High
  Performance).
  Its hardware configuration registers allow to dynamically expose its features.

  GPDMA and HPDMA support 16 independent DMA channels, while only 4 for LPDMA.
  GPDMA and HPDMA support 256 DMA requests from peripherals, 8 for LPDMA.

  Bindings are generic for these 3 STM32 DMA3 configurations.

  DMA clients connected to the STM32 DMA3 controller must use the format
  described in "#dma-cells" property description below, using a three-cell
  specifier for each channel.

maintainers:
  - Amelie Delaunay <amelie.delaunay@foss.st.com>

properties:
  compatible:
    enum:
      - st,stm32mp21-dma3
      - st,stm32mp25-dma3

  reg:
    maxItems: 1

  interrupts:
    minItems: 4
    maxItems: 16
    description:
      Should contain all of the per-channel DMA interrupts in ascending order
      with respect to the DMA channel index.

  clocks:
    maxItems: 1

  resets:
    maxItems: 1

  lli-bus-interface:
    $ref: /schemas/types.yaml#/definitions/uint32
    enum: [0, 1]
    default: 0
    description:
      To select port 1 for fetching linked-list items (LLIs).
      If not defined, port 0 is used by default.

  memory-region:
    maxItems: 1
    description:
      Phandle to a /reserved-memory child node assigned to STM32 DMA3 for linked-list items
      allocation. When not defined, linked-list items are allocated in DDR.
      During transfer, STM32 DMA3 updates its registers reading the linked-list items in memory.
      These reads are 32-bit single reads. Allocating the linked-list items in internal RAM improves
      STM32 DMA3 performance.

  power-domains:
    maxItems: 1

  st,syscfg-arcr:
    description: |
      Phandle to system configuration controller. It is used to get the status of the STM32 DMA3 AXI
      port address remapping. When enabled, the 4GB address space accessible by the STM32 DMA3 AXI
      port starts at address 0x80000000 instead of 0x00000000.
    $ref: /schemas/types.yaml#/definitions/phandle-array
    items:
      - items:
          - description: phandle to syscfg
          - description: register offset within syscfg
          - description: register bitmask for DMA controller Address Remapping ENable (AREN) bit

  st,protreg:
    minItems: 1
    maxItems: 16
    $ref: "/schemas/types.yaml#/definitions/uint32-array"
    description:
      Describes the firewall hardware configuration to apply for a
      given channel. Applicable for platforms implementing the RIF.

      RIFPROT(hpdma_chan_id, sem_list, lock, sec, priv, scid, sem_en, cfen)

      When a field isn't effective, it should be filled with RIF_UNUSED.

        "hpdma_chan_id" The HPDMA channel number.

        "sem_list" Contains the CID grantlist that can access the
                    channel (multiple choice allowed) when the
                    channel is configured in semaphore mode. Mandates
                    CID filtering and semaphore enabled to be effective.
          RIF_CID1_BF | RIF_CID4_BF, allows both CID (Compartment ID)
                                      1/4 to access the channel
                                      according to the RIF semaphore
                                      rules

        "lock" Specifies whether the RIF configuration is locked until
                next platform reset for this channel.
          RIF_UNLOCK, the RIF configuration will not be locked for this channel
          RIF_LOCK, the RIF configuration will be locked and will not be
                    editable until next platform reset for this channel

        "sec" Configures secure-only access to the channel.
          RIF_SEC, only secure access is granted to the channel
          RIF_NSEC, secure/non-secure access is granted to the channel

        "priv" Configures the privilege level needed to access this channel.
          RIF_PRIV, only privileged access is granted to the channel
          RIF_NPRIV, privileged/Unprivileged access is granted to the channel

        "scid" Configures the static CID that is allowed to access the channel.
                Note that the static CID configuration is ineffective if the
                semaphore mode is enabled. It mandates CID filtering enabled
                to be effective.
          RIF_CID1 allows CID 1 to access the channel
          RIF_CID2 allows CID 2 to access the channel ...

        "sem_en" Enable/disable the semaphore mode for this channel.
                  It mandates CID filtering enabled to be effective.
          RIF_SEM_EN, semaphore mode enabled
          RIF_SEM_DIS, semaphore mode disabled

        "cfen" Enable/disable the CID filtering for this channel.
          RIF_CFEN, enables the CID filtering
          RIF_CFDIS, disables the CID filtering

  "#dma-cells":
    const: 3
    description: |
      Specifies the number of cells needed to provide DMA controller specific
      information.
      The first cell is the request line number.
      The second cell is a 32-bit mask specifying the DMA channel requirements:
        -bit 0-1: The priority level
          0x0: low priority, low weight
          0x1: low priority, mid weight
          0x2: low priority, high weight
          0x3: high priority
        -bit 4-7: The FIFO requirement for queuing source/destination transfers
          0x0: no FIFO requirement/any channel can fit
          0x2: FIFO of 8 bytes (2^2+1)
          0x4: FIFO of 32 bytes (2^4+1)
          0x6: FIFO of 128 bytes (2^6+1)
          0x7: FIFO of 256 bytes (2^7+1)
      The third cell is a 32-bit mask specifying the DMA transfer requirements:
        -bit 0: The source incrementing burst
          0x0: fixed burst
          0x1: contiguously incremented burst
        -bit 1: The source allocated port
          0x0: port 0 is allocated to the source transfer
          0x1: port 1 is allocated to the source transfer
        -bit 4: The destination incrementing burst
          0x0: fixed burst
          0x1: contiguously incremented burst
        -bit 5: The destination allocated port
          0x0: port 0 is allocated to the destination transfer
          0x1: port 1 is allocated to the destination transfer
        -bit 8: The type of hardware request
          0x0: burst
          0x1: block
        -bit 9: The control mode
          0x0: DMA controller control mode
          0x1: peripheral control mode
        -bit 12-13: The transfer complete event mode
          0x0: at block level, transfer complete event is generated at the end
               of a block
          0x2: at LLI level, the transfer complete event is generated at the end
               of the LLI transfer
               including the update of the LLI if any
          0x3: at channel level, the transfer complete event is generated at the
               end of the last LLI
        -bit 16: Prevent packing/unpacking mode
          0x0: pack/unpack enabled when source data width/burst != destination data width/burst
          0x1: memory data width/burst forced to peripheral data width/burst to prevent pack/unpack
        -bit 17: Prevent additional transfers due to linked-list refactoring
          0x0: don't prevent additional transfers for optimal performance
          0x1: prevent additional transfer to accommodate user constraints such as single transfer

allOf:
  - $ref: /schemas/dma/dma-controller.yaml#
  - if:
      properties:
        compatible:
          contains:
            const: st,stm32mp21-dma3
    then:
      required:
        - st,syscfg-arcr
    else:
      properties:
        st,syscfg-arcr: false

required:
  - compatible
  - reg
  - interrupts
  - clocks
  - "#dma-cells"

unevaluatedProperties: false

examples:
  - |
    // Example 1 on STM32MP25
    #include <dt-bindings/interrupt-controller/arm-gic.h>
    #include <dt-bindings/clock/st,stm32mp25-rcc.h>

    reserved-memory {
      #address-cells = <2>;
      #size-cells = <2>;

      dma_lli: dma-lli@a020000 {
        reg = <0x0 0xa020000 0x0 0x10000>;
        no-map;
      };
    };

    dma-controller@40400000 {
      compatible = "st,stm32mp25-dma3";
      reg = <0x40400000 0x1000>;
      interrupts = <GIC_SPI 33 IRQ_TYPE_LEVEL_HIGH>,
                   <GIC_SPI 34 IRQ_TYPE_LEVEL_HIGH>,
                   <GIC_SPI 35 IRQ_TYPE_LEVEL_HIGH>,
                   <GIC_SPI 36 IRQ_TYPE_LEVEL_HIGH>,
                   <GIC_SPI 37 IRQ_TYPE_LEVEL_HIGH>,
                   <GIC_SPI 38 IRQ_TYPE_LEVEL_HIGH>,
                   <GIC_SPI 39 IRQ_TYPE_LEVEL_HIGH>,
                   <GIC_SPI 40 IRQ_TYPE_LEVEL_HIGH>,
                   <GIC_SPI 41 IRQ_TYPE_LEVEL_HIGH>,
                   <GIC_SPI 42 IRQ_TYPE_LEVEL_HIGH>,
                   <GIC_SPI 43 IRQ_TYPE_LEVEL_HIGH>,
                   <GIC_SPI 44 IRQ_TYPE_LEVEL_HIGH>,
                   <GIC_SPI 45 IRQ_TYPE_LEVEL_HIGH>,
                   <GIC_SPI 46 IRQ_TYPE_LEVEL_HIGH>,
                   <GIC_SPI 47 IRQ_TYPE_LEVEL_HIGH>,
                   <GIC_SPI 48 IRQ_TYPE_LEVEL_HIGH>;
      clocks = <&rcc CK_BUS_HPDMA1>;
      #dma-cells = <3>;
      lli-bus-interface = <1>;
      memory-region = <&dma_lli>;
    };

  - |
    // Example 2 on STM32MP21
    #include <dt-bindings/interrupt-controller/arm-gic.h>

    soc {
      #address-cells = <1>;
      #size-cells = <2>;

      dma-controller@40400000 {
        compatible = "st,stm32mp21-dma3";
        reg = <0x40400000 0x0 0x1000>;
        interrupts = <GIC_SPI 31 IRQ_TYPE_LEVEL_HIGH>,
                    <GIC_SPI 32 IRQ_TYPE_LEVEL_HIGH>,
                    <GIC_SPI 33 IRQ_TYPE_LEVEL_HIGH>,
                    <GIC_SPI 34 IRQ_TYPE_LEVEL_HIGH>,
                    <GIC_SPI 35 IRQ_TYPE_LEVEL_HIGH>,
                    <GIC_SPI 36 IRQ_TYPE_LEVEL_HIGH>,
                    <GIC_SPI 37 IRQ_TYPE_LEVEL_HIGH>,
                    <GIC_SPI 38 IRQ_TYPE_LEVEL_HIGH>,
                    <GIC_SPI 39 IRQ_TYPE_LEVEL_HIGH>,
                    <GIC_SPI 40 IRQ_TYPE_LEVEL_HIGH>,
                    <GIC_SPI 41 IRQ_TYPE_LEVEL_HIGH>,
                    <GIC_SPI 42 IRQ_TYPE_LEVEL_HIGH>,
                    <GIC_SPI 43 IRQ_TYPE_LEVEL_HIGH>,
                    <GIC_SPI 44 IRQ_TYPE_LEVEL_HIGH>,
                    <GIC_SPI 45 IRQ_TYPE_LEVEL_HIGH>,
                    <GIC_SPI 46 IRQ_TYPE_LEVEL_HIGH>;
        clocks = <&rcc 95>;
        #dma-cells = <3>;
        st,syscfg-arcr = <&syscfg 0x2050 0x1>;
      };
    };

...
```

## documentation/devicetree/bindings/rng/st,stm32-rng.yaml
```yaml
# SPDX-License-Identifier: (GPL-2.0-only OR BSD-2-Clause)
%YAML 1.2
---
$id: http://devicetree.org/schemas/rng/st,stm32-rng.yaml#
$schema: http://devicetree.org/meta-schemas/core.yaml#

title: STMicroelectronics STM32 RNG

description: |
  The STM32 hardware random number generator is a simple fixed purpose
  IP and is fully separated from other crypto functions.

maintainers:
  - Lionel Debieve <lionel.debieve@foss.st.com>

properties:
  compatible:
    enum:
      - st,stm32-rng
      - st,stm32mp13-rng
      - st,stm32mp21-rng
      - st,stm32mp25-rng

  reg:
    maxItems: 1

  clocks:
    minItems: 1
    maxItems: 2

  clock-names:
    items:
      - const: core
      - const: bus

  resets:
    maxItems: 1

  clock-error-detect:
    type: boolean
    description: If set enable the clock detection management

  access-controllers:
    minItems: 1
    maxItems: 2

required:
  - compatible
  - reg
  - clocks

allOf:
  - if:
      properties:
        compatible:
          contains:
            enum:
              - st,stm32mp13-rng
              - st,stm32mp25-rng
    then:
      properties:
        st,rng-lock-conf:
          type: boolean
          description: If set, the RNG configuration in RNG_CR, RNG_HTCR and
                       RNG_NSCR will be locked.

  - if:
      properties:
        compatible:
          contains:
            enum:
              - st,stm32-rng
              - st,stm32mp13-rng
    then:
      properties:
        clocks:
          maxItems: 1
        clock-names: false
    else:
      properties:
        clocks:
          minItems: 2

        clock-names:
          items:
            - const: rng_clk  # RNG kernel clock
            - const: rng_hclk # RNG bus clock

      required:
        - clock-names

  - if:
      properties:
        compatible:
          contains:
            enum:
              - st,stm32mp13-rng
              - st,stm32mp21-rng
              - st,stm32mp25-rng
    then:
      properties:
        st,rng-cfg:
          minItems: 1
          maxItems: 3
          type: boolean
          description: The configuration bitfields to initialize the RNG. They
                       must be listed in the numerical order. If not specified,
                       the default hard-coded values will be used. Number of
                       values depends on the presence of
                       st,rng-nist-custom property.

        st,rng-cfg-nist-custom:
          type: boolean
          description: Enable custom values for NIST compliant RNG.

        st,rng-htcfg:
          maxItems: 1
          description: The values to configure health tests. If not specified,
                       the default hard-coded values will be used.

additionalProperties: false

examples:
  - |
    #include <dt-bindings/clock/stm32mp1-clks.h>
    rng@54003000 {
      compatible = "st,stm32-rng";
      reg = <0x54003000 0x400>;
      clocks = <&rcc RNG1_K>;
    };

...
```
