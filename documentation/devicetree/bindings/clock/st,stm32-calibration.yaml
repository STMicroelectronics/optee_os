## documentation/devicetree/bindings/clock/st,stm32-calibration.yaml
```yaml
# SPDX-License-Identifier: (GPL-2.0-only OR BSD-2-Clause)
%YAML 1.2
---
$id: http://devicetree.org/schemas/clock/st,stm32-calibration.yaml#
$schema: http://devicetree.org/meta-schemas/core.yaml#

title: STMicroelectronics STM32 clock calibration

maintainers:
  - Gatien Chevallier <gatien.chevallier@st.com>

description: |
  STMicroelectronics's STM32 MPUs embed a clock calibration system for
  internal oscillators whose frequency can be affected by temperature and
  voltage variations:
  * HSI, CSI for STM32MP1 family
  * HSI, MSI for STM32MP2 family
  The clock calibration algorithm is based on the comparison of a timer
  (fed by this oscillator) and a clock that is derived from the HSE clock that
  is considered always accurate.

properties:
  compatible:
    const: "st,osc-calibration"

patternProperties:
  "^[a-z]{3}-calibration":
    type: object
    properties:
      compatible:
        enum:
          - "st,csi-cal"
          - "st,hsi-cal"
          - "st,msi-cal"
      counter:
        description: counter used to calibrate
          Refer to counter.yaml for more details.
        maxItems: 1

    required:
      - compatible
      - counter

required:
  - compatible

additionalProperties: false

examples:
- |
    osc_calibration: osc-calibration {
      compatible = "st,osc-calibration";

      csi_calibration: csi-calibration {
        compatible = "st,csi-cal";
        counter = <&timers15 0 8>;
        status = "disabled";
      };

      hsi_calibration: hsi-calibration {
        compatible = "st,hsi-cal";
        counter = <&timers15 0 7>;
        status = "disabled";
      };
    };
...
```

## documentation/devicetree/bindings/mfd/st,stpmic2.yaml
```yaml
# SPDX-License-Identifier: (GPL-2.0-only OR BSD-2-Clause)
%YAML 1.2
---
$id: http://devicetree.org/schemas/mfd/st,stpmic2.yaml#
$schema: http://devicetree.org/meta-schemas/core.yaml#

title: STMicroelectonics STPMIC2 Power Management IC bindings

description: STMicroelectronics STPMIC2 Power Management IC

maintainers:
  - pascal Paillet <p.paillet@st.com>

properties:
  compatible:
    enum:
      - st,stpmic1l
      - st,stpmic2
      - st,stpmic2l

    description: |
      The STPMIC25 uses "st,stpmic2" compatible string and can provide
      BUCK1..7, LDO1..7, REFDDR regulators
      The STPMIC1L uses "st,stpmic1l" compatible string and can provide
      BUCK1, BUCK2, LDO2..5, GPO1..2 regulators
      The STPMIC2L uses "st,stpmic2l" compatible string and can provide
      BUCK1..4, LDO1..LDO7, GPO1..5 regulators
  reg:
    const: 0x33

  interrupts:
    maxItems: 1

  st,pmic-it-id:
    description: PMIC interruptions ids to forward to the non-secure world
      in the form of OPTEE notifications described by st,notif-it-id.
        PKEY_FA = 0
        PKEY_RI = 1
        WKP_FA = 2
        WKP_RI = 3
        VINLOW_FA = 4
        VINLOW_RI = 5
        VBUS_FA = 6
        VBUS_RI = 7
        THW_FA = 8
        THW_RI = 9
        BUCK1_OCP = 16
        BUCK2_OCP = 17
        BUCK3_OCP = 18
        BUCK4_OCP = 19
        BUCK5_OCP = 20
        BUCK6_OCP = 21
        BUCK7_OCP = 22
        REFDDR_OC = 23
        LDO1_OCP2 = 24
        LDO2_OCP2 = 25
        LDO3_OCP2 = 26
        LDO4_OCP2 = 27
        LDO5_OCP2 = 28
        LDO6_OCP2 = 29
        LDO7_OCP3 = 30
        LDO8_OCP3 = 31
    $ref: /schemas/types.yaml#/definitions/uint32-array
    minItems: 1
    maxItems: 32

  st,notif-it-id:
    description: OP-TEE notification IDs to forward to the non-secure world
      for each PMIC interruption listed by st,pmic-it-id.
    $ref: /schemas/types.yaml#/definitions/uint32-array
    minItems: 1
    maxItems: 32

  regulators:
    type: object

    description: |
      Available regulators in STPMIC2 devices are:
        - buck1..7 for BUCK1..7
        - ldo1..8 for LDO1..8
        - gpo1..5 for GDO1..5
        - refddr for REFDDR

    properties:
      compatible:
        const: st,stpmic2-regulators

    patternProperties:
      "^(buck[1-7]|ldo[1-8]|gdo[1-5]|refddr)$":
        type: object
        $ref: ../regulator/regulator.yaml

        properties:
          st,mask-reset:
            description: mask reset for this regulator, the regulator
              configuration is maintained during STPMIC2 reset cycle.
            $ref: /schemas/types.yaml#/definitions/flag

          st,regulator-bypass-microvolt:
            description: regulator output voltage when configured in bypass.
              Authorize automatic bypass mode selection depending on voltage.
              Available only for LDO2, LDO3, LDOs5-8.

          st,alternate-input-source:
            description: select VOUT4 as input source for LDO1.
            $ref: /schemas/types.yaml#/definitions/flag

          st,pwrctrl-enable:
            description: Enable the power control input line for the regulator.
            $ref: /schemas/types.yaml#/definitions/flag

          st,pwrctrl-sel:
            description: Power control input line number to use to drive
              the regulator low power state.
            $ref: /schemas/types.yaml#/definitions/uint32

          st,pwrctrl-reset:
            description: The regulator state is reset to it's NVMEM default
              value when exit from low power. It is disabled when the
              power control line is low.
            $ref: /schemas/types.yaml#/definitions/flag

        patternProperties:
          "^(default|lplv|standby|off|lp-stop|lplv-stop|lplv-stop2|standby-ddr-sr|standby-ddr-off)$":
            type: object
            description:
              sub-nodes for regulator low power states.
              On STM32MP1:
                lp-stop is applied for LP-STOP
                lplv-stop is applied for LPLV-STOP
                lplv-stop2 is applied for LPLV-STOP2
                standby-ddr-sr is applied for STANDBY-DDR-SR
                standby-ddr-off is applied before shutdown
              On STM32MP2:
                default is applied for STOP1, LP-STOP1, STOP2, LP-STOP2
                lplv is applied for LPLV-STOP1, LPLV-STOP2
                standby is applied for STANDBY1-DDR-SR
                off is applied for STANDBY-DDR-OFF

            properties:
              regulator-on-in-suspend:
                description: regulator should be on in suspend state.
                type: boolean

              regulator-off-in-suspend:
                description: regulator should be off in suspend state.
                  If it is controlled by a pwrctrl line, it is turned off
                  once the pwrctrl state changes.
                  If st,pwrctrl-enable is false, it is turned off during
                  suspend preparation and re-enabled during resume.
                type: boolean

              regulator-suspend-microvolt:
                description: the voltage which regulator should be set in
                  suspend.

      "^(buck[1-7]|ldo[1-8]|refddr)-supply$":
        description: STPMIC2 voltage regulators supplies

    additionalProperties: false

additionalProperties: false

required:
  - compatible
  - reg

examples:
  - |
    #include <dt-bindings/mfd/st,stpmic2.h>
    i2c {
      #address-cells = <1>;
      #size-cells = <0>;
      pmic@33 {
        compatible = "st,stpmic2";
        reg = <0x33>;

        interrupts-extended = <&exti1 52 IRQ_TYPE_EDGE_FALLING>;
        st,pmic-it-id = <IT_PKEY_FA IT_PKEY_RI>;
        st,notif-it-id = <0 1>;

        regulators {
          compatible = "st,stpmic2-regulators";

          ldo6-supply = <&v3v3>;

          buck1 {
            regulator-name = "vdd_core";
            st,pwrctrl-sel = <1>;
            st,pwrctrl-enable;
            regulator-min-microvolt = <1200000>;
            regulator-max-microvolt = <1200000>;
            default {
              regulator-on-in-suspend;
              regulator-suspend-microvolt = <1200000>;
            };
            lplv {
              regulator-on-in-suspend;
              regulator-suspend-microvolt = <700000>;
            };
            standby {
              regulator-off-in-suspend;
            };
            off {
              regulator-off-in-suspend;
            };
          };

          buck3 {
            regulator-name = "vdd";
            regulator-min-microvolt = <3300000>;
            regulator-max-microvolt = <3300000>;
            regulator-boot-on;
            regulator-pull-down;
            st,mask-reset;
          };

          buck4 {
            regulator-name = "v3v3";
            regulator-min-microvolt = <3300000>;
            regulator-max-microvolt = <3300000>;
            regulator-always-on;
            regulator-over-current-protection;
          };

          ldo6 {
            regulator-name = "v1v8";
            regulator-min-microvolt = <1800000>;
            regulator-max-microvolt = <1800000>;
          };

          ldo8 {
            regulator-name = "vddio_sdcard";
            regulator-min-microvolt = <1800000>;
            regulator-max-microvolt = <3300000>;
            regulator-always-on;
            st,regulator-bypass-microvolt = <3300000>;
          };
        };
      };
    };
...
```
