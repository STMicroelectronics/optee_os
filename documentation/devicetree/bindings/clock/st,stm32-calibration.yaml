## documentation/devicetree/bindings/scmi/scmi.yaml
```yaml
# SPDX-License-Identifier: (GPL-2.0-only OR BSD-2-Clause)
%YAML 1.2
---
$id: http://devicetree.org/schemas/scmi/scmi.yaml#
$schema: http://devicetree.org/meta-schemas/core.yaml#

maintainers:
  - Valentin Caron <valentin.caron@foss.st.com>

title: System Control and Management Interface (SCMI) server

description: |
  The SCMI is intended to allow agents to manage various functions
  that are provided by the hardware platform it is running on, including power
  and performance functions.

  This binding is intended to define in the device tree the interface implementing
  the SCMI, as described in ARM document number ARM DEN 0056 ("ARM System Control
  and Management Interface Platform Design Document")[0], provided by OP-TEE
  that is acting as a platform controller.

  [0] https://developer.arm.com/documentation/den0056/latest

properties:
  compatible:
    const: optee,scmi-server

  "#address-cells":
    const: 1
  "#size-cells":
    const: 0

patternProperties:
  "^agent@[0-9a-f]+$":
    type: object
    description: |
      SCMI Agent, describe the communication configuration and services exposed to an SCMI agent.
    properties:
      compatible:
        enum:
          - linaro,scmi-optee
          - arm,scmi

      reg:
        description: Identifier of the agent
        maxItems: 1
        minimum: 1

      scmi-channel-id:
        description: Channel identifier used by the agent
        maxItems: 1

      mboxes:
        $ref: /schemas/types.yaml#/definitions/phandle-array
        description: |
          Mailbox between client and server to notify for a new SCMI message.
        maxItem: 1

      mbox-names:
        $ref: /schemas/types.yaml#/definitions/string-array
        description: Mailbox informative name.
        maxItem: 1

      shmem:
        $ref: /schemas/types.yaml#/definitions/phandle
        description: |
          Shared memory between client and server to exchange SCMI messages.
        maxItem: 1

      "#address-cells":
        const: 1

      "#size-cells":
        const: 0

      protocol@11:
        $ref: '#/$defs/protocol-node'
        unevaluatedProperties: false
        description: |
          Describe resources exposed with power domain management protocol
        properties:
          reg:
            description: Identifier of the power domain management protocol
            const: 0x11
          power-domains:
            maxItems: 1
            type: object
            properties:
              "#address-cells":
                const: 1
              "#size-cells":
                const: 0
            patternProperties:
              "^pd@[0-9a-f]+$":
                type: object
                properties:
                  reg:
                    description: Identifier for the power domain
                    maxItems: 1
                  clocks:
                    maxItems: 1
                  voltd-supply:
                    maxItems: 1
                  domain-name:
                    description: Name for the power domain
                    maxItems: 1
                required:
                  - reg
                  - clocks
                  - voltd-supply
            required:
              - "#address-cells"
              - "#size-cells"

      protocol@14:
        $ref: '#/$defs/protocol-node'
        unevaluatedProperties: false
        description: |
          Describe resources exposed with clock management protocol
        properties:
          reg:
            description: Identifier of the clock management protocol
            const: 0x14
          clocks:
            type: object
            properties:
              "#address-cells":
                const: 1
              "#size-cells":
                const: 0
            patternProperties:
              "^clock@[0-9a-f]+$":
                type: object
                properties:
                  reg:
                    description: Identifier for the clock device
                    maxItems: 1
                  clocks:
                    maxItems: 1
                  domain-name:
                    description: Name for the clock device
                    maxItems: 1
                required:
                  - reg
                  - clocks
            required:
              - "#address-cells"
              - "#size-cells"

      protocol@16:
        $ref: '#/$defs/protocol-node'
        unevaluatedProperties: false
        description: |
          Describe resources exposed with reset domain management protocol
        properties:
          reg:
            description: Identifier of the reset domain management protocol
            const: 0x16
          resets:
            type: object
            properties:
              "#address-cells":
                const: 1
              "#size-cells":
                const: 0
            patternProperties:
              "^reset@[0-9a-f]+$":
                type: object
                properties:
                  reg:
                    description: Identifier for the reset domain
                    maxItems: 1
                  resets:
                    maxItems: 1
                  domain-name:
                    description: Name for the reset domain
                    maxItems: 1
                required:
                  - reg
                  - resets
            required:
              - "#address-cells"
              - "#size-cells"

      protocol@17:
        $ref: '#/$defs/protocol-node'
        unevaluatedProperties: false
        description: |
          Describe resources exposed with voltage domain management protocol
        properties:
          reg:
            description: Identifier of the voltage domain management protocol
            const: 0x17
          regulators:
            type: object
            properties:
              "#address-cells":
                const: 1
              "#size-cells":
                const: 0
            patternProperties:
              "^regulator@[0-9a-f]+$":
                type: object
                properties:
                  reg:
                    description: Identifier for the voltage domain
                    maxItems: 1
                  voltd-supply:
                    maxItems: 1
                  domain-name:
                    description: Name for the voltage domain
                    maxItems: 1
                required:
                  - reg
                  - voltd-supply
            required:
              - "#address-cells"
              - "#size-cells"

    required:
      - compatible
      - reg
      - scmi-channel-id
      - "#address-cells"
      - "#size-cells"

    allOf:
      - if:
          properties:
            compatible:
              contains:
                const: arm,scmi
        then:
          required:
            - mboxes
            - shmem

required:
  - compatible
  - "#address-cells"
  - "#size-cells"

unevaluatedProperties: false

$defs:
  protocol-node:
    maxItems: 1
    properties:
      reg:
        maxItems: 1
      "#address-cells":
        const: 1
      "#size-cells":
        const: 0
    required:
      - reg
      - "#address-cells"
      - "#size-cells"

examples:
  - |
    #include <dt-bindings/scmi/scmi-clock.h>

    scmi {
      compatible = "optee,scmi-server";
      #address-cells = <1>;
      #size-cells = <0>;

      agent@1 {
        reg = <1>;
        compatible = "linaro,scmi-optee";
        scmi-channel-id = <0>;
        #address-cells = <1>;
        #size-cells = <0>;

        protocol@11 {
          reg = <0x11>;

          power-domains {
            #address-cells = <1>;
            #size-cells = <0>;

            pd@0 {
              reg = <0>;
              clocks = <&clock_drv 36>;
              voltd-supply = <&voltd_drv 72>;
              domain-name = "pd";
            };
          };
        };

        protocol@14 {
          reg = <0x14>;

          clocks {
            #address-cells = <1>;
            #size-cells = <0>;

            clock@0 {
              reg = <0>;
              domain-name = "clock";
              clocks = <&clock_drv 25>;
              flags = <SCMI_CLOCK_DEFAULT_ENABLED | SCMI_CLOCK_ALLOW_SET_RATE>;
            };
          };
        };

        protocol@16 {
          reg = <0x16>;

          resets {
            #address-cells = <1>;
            #size-cells = <0>;

            reset@0 {
              reg = <0>;
              domain-name = "reset";
              resets = <&reset_drv 53>;
            };
          };
        };

        protocol@17 {
          reg = <0x17>;

          regulators {
            #address-cells = <1>;
            #size-cells = <0>;

            voltd@0 {
              reg = <0>;
              voltd-supply = <&voltd_drv 84>;
            };
          };
        };
      };
    };
```

## documentation/devicetree/bindings/soc/stm32/st,stm32-irq-notifier.yaml
```yaml
# SPDX-License-Identifier: (GPL-2.0-only OR BSD-2-Clause)
%YAML 1.2
---
$id: http://devicetree.org/schemas/soc/stm32/st,stm32-irq-notifier.yaml#
$schema: http://devicetree.org/meta-schemas/core.yaml#

title: STM32 irq client to notify NS

maintainers:
  - Antonio Borneo <antonio.borneo@foss.st.com>

properties:
  compatible:
    const: "st,stm32-irq-notifier"

  interrupts:
    maxItems: 1
    description: A single interrupt specifier

  wakeup-source:
    type: boolean
    description: Interrupt can be used as a wakeup source

  st,notif-it-id:
    description: OPTEE notification number to send to the non-secure world.
    $ref: /schemas/types.yaml#/definitions/uint32

required:
  - compatible
  - interrupts

additionalProperties: false

examples:
  - |
    typec_wakeup {
      compatible = "st,stm32-irq-notifier";
      interrupts-extended = <&exti 59 IRQ_TYPE_EDGE_FALLING>;
      wakeup-source;
      st,notif-it-id = <1>;
    };
```

## documentation/devicetree/bindings/soc/stm32/st,stm32mp21-dbgmcu-mbx.yaml
```yaml
# SPDX-License-Identifier: (GPL-2.0-only OR BSD-2-Clause)
%YAML 1.2
---
$id: http://devicetree.org/schemas/soc/stm32/st,stm32mp21-dbgmcu-mbx.yaml#
$schema: http://devicetree.org/meta-schemas/core.yaml#

title: STM32 DBGMCU secure debug mailbox for Authenticated Debug Access Control

maintainers:
  - Amelie Delaunay <amelie.delaunay@foss.st.com>

description: |
  On STM32MP21, the debug authentication protocol implements a bidirectional
  communication between the debugger (host) and the target (STM32MP21) through
  a mailbox interface located in the DBGMCU.

properties:
  compatible:
    const: st,stm32mp21-dbgmcu-mbx

  reg:
    maxItems: 1

  clocks:
    maxItems: 1

  interrupts:
    items:
      - description: Detection of debugger write in DBG_AUTH_HOST register
      - description: Detection of debugger read DBG_AUTH_DEV register

  interrupt-names:
    items:
      - const: dbg_auth_wr
      - const: dbg_auth_rd

required:
  - compatible
  - reg
  - clocks
  - interrupts
  - interrupt-names

additionalProperties: false

examples:
  - |
        dbgmcu_mbx: mailbox@440a0100 {
          compatible = "st,stm32mp21-dbgmcu-mbx";
          reg = <0x440a0100 0xc>;
          interrupts = <GIC_SPI 208 IRQ_TYPE_LEVEL_HIGH>,
                       <GIC_SPI 209 IRQ_TYPE_EDGE_RISING>;
          interrupt-names = "dbg_auth_wr", "dbg_auth_rd";
          clocks = <&rcc CK_DBGMCU>;
        };
```

## documentation/devicetree/bindings/soc/stm32/vivante,gc.yaml
```yaml
# SPDX-License-Identifier: (GPL-2.0-only OR BSD-2-Clause)
%YAML 1.2
---
$id: http://devicetree.org/schemas/soc/stm32/vivante,gc#
$schema: http://devicetree.org/meta-schemas/core.yaml#

title: STM32 GPU bindings

maintainers:
  - Pascal Paillet <p.paillet@foss.st.com>

properties:
  compatible:
    const: "st,stm32-gpu"

  "#address-cells":
    const: 1

  "#size-cells":
    const: 1

  reg:
    maxItems: 1

  clocks:
    maxItems: 1

  gpu-supply:
    description: "Power supply for the GPU"
    $ref: "/schemas/regulator/regulator.yaml#"

  operating-points-v2:
    description: "Operating points for the GPU"
    $ref: "/schemas/opp/opp-v2.yaml#"

required:
  - compatible
  - clocks
  - gpu-supply

additionalProperties: false

examples:
  - |
    #include <dt-bindings/clock/stm32mp25-clks.h>
    gpu0: gpu@48280000 {
      compatible = "vivante,gc";
      gpu-supply = <&vddgpu>;
      clocks = <&rcc CK_BUS_GPU>;
      operating-points-v2 = <&gpu0_opp_table>;
    };

    gpu0_opp_table: gpu0-opp-table {
      compatible = "operating-points-v2";

      opp-800000000 {
        opp-hz = /bits/ 64 <800000000>;
        opp-microvolt = <800000>;
        opp-supported-hw = <0x3>;
        st,opp-default;
      };

      opp-900000000 {
        opp-hz = /bits/ 64 <900000000>;
        opp-microvolt = <1200000>;
        opp-supported-hw = <0x2>;
      };
    };

...
```
