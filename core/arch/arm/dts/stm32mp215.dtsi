// SPDX-License-Identifier: (GPL-2.0-only OR BSD-3-Clause)
/*
 * Copyright (C) 2025, STMicroelectronics - All Rights Reserved
 * Author: Alexandre Torgue <alexandre.torgue@foss.st.com> for STMicroelectronics.
 */
#include "stm32mp213.dtsi"

&soc1 {
	ltdc: display-controller@48010000 {
		compatible = "st,stm32-ltdc";
		reg = <0x48010000 0x400>;
		interrupts = <GIC_SPI 143 IRQ_TYPE_LEVEL_HIGH>,
			     <GIC_SPI 144 IRQ_TYPE_LEVEL_HIGH>;
		clocks = <&rcc CK_BUS_LTDC>, <&rcc CK_KER_LTDC>;
		clock-names = "bus", "lcd";
		resets = <&rcc LTDC_R>;
		status = "disabled";
		access-controllers = <&rifsc STM32MP21_RIFSC_LTDC_CMN_ID>;
		access-controller-names = "cmn";

		l1l2 {
			access-controllers = <&rifsc STM32MP21_RIFSC_LTDC_L1L2_ID>;
			access-controller-names = "l1l2";
		};
		l3 {
			access-controllers = <&rifsc STM32MP21_RIFSC_LTDC_L3_ID>;
			access-controller-names = "l3";
		};
	};
};
